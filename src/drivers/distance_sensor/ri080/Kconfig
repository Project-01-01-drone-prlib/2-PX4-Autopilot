## src/drivers/distance_sensor/ri080/Kconfig
```kconfig
menuconfig DRIVERS_DISTANCE_SENSOR_RI080
	bool "RI080"
	default n
	---help---
		Enable support for RI080
```

## src/drivers/optical_flow/ano_tc_v4/Kconfig
```kconfig
menuconfig DRIVERS_OPTICAL_FLOW_ANO_TC_V4
	bool "ano_tc_v4"
	default n
	---help---
		Enable support for PixArt ano_tc_v4
```

## src/drivers/optical_flow/anotcflowv4/Kconfig
```kconfig
menuconfig DRIVERS_OPTICAL_FLOW_ANOTCFLOWV4
	bool "anotcflowv4"
	default n
	---help---
		Enable support for anotcflowv4
```
